#include "boot_animation.h"
#include "../config/cfg_display.h"

#define LOGO_TRI_COUNT 162
static const int16_t LOGO_TRIS[][6] PROGMEM = {
  {120,105,65,134,100,114},{120,105,100,114,101,113},{120,105,101,113,100,112},
  {120,105,100,112,99,112},{120,105,99,112,93,111},{120,105,93,111,73,111},
  {120,105,73,111,55,110},{120,105,55,110,38,109},{120,105,38,109,34,108},
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  {120,105,49,146,51,144},{120,105,51,144,65,134},{120,105,65,134,65,134},
};

#define LOGO_SEG_COUNT 162
static const int16_t LOGO_SEGS[][4] PROGMEM = {
  {65,134,100,114},{100,114,101,113},{101,113,100,112},{100,112,99,112},
  {99,112,93,111},{93,111,73,111},{73,111,55,110},{55,110,38,109},
  {38,109,34,108},{34,108,30,103},{30,103,30,100},{30,100,34,98},
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  {51,144,65,134},{65,134,65,134},
};

static Adafruit_ST7789* _tft_ptr = nullptr;
static WebServer* _server_ptr = nullptr;
static uint16_t _orange;

static void drawLogoFilled(uint16_t bg, uint16_t fg) {
    auto& tft = *_tft_ptr;
    tft.fillScreen(bg);
    for (uint16_t i = 0; i < LOGO_TRI_COUNT; i++) {
        tft.fillTriangle(
            pgm_read_word(&LOGO_TRIS[i][0]), pgm_read_word(&LOGO_TRIS[i][1]),
            pgm_read_word(&LOGO_TRIS[i][2]), pgm_read_word(&LOGO_TRIS[i][3]),
            pgm_read_word(&LOGO_TRIS[i][4]), pgm_read_word(&LOGO_TRIS[i][5]),
            fg);
    }
    tft.setTextColor(fg);
    tft.setTextSize(2);
    tft.setCursor(66, 210);
    tft.print("Anthropic");
    tft.setCursor(67, 210);
    tft.print("Anthropic");
}

static void animLogoReveal() {
    auto& tft = *_tft_ptr;
    tft.fillScreen(_orange);
    for (uint16_t i = 0; i < LOGO_SEG_COUNT; i++) {
        int16_t x1 = pgm_read_word(&LOGO_SEGS[i][0]);
        int16_t y1 = pgm_read_word(&LOGO_SEGS[i][1]);
        int16_t x2 = pgm_read_word(&LOGO_SEGS[i][2]);
        int16_t y2 = pgm_read_word(&LOGO_SEGS[i][3]);
        tft.drawLine(x1, y1, x2, y2, ST77XX_WHITE);
        tft.drawLine(x1 + 1, y1, x2 + 1, y2, ST77XX_WHITE);
        if (i % 4 == 0) {
            if (_server_ptr) _server_ptr->handleClient();
            delay(8);
        }
    }
    drawLogoFilled(_orange, ST77XX_WHITE);
    delay(1500);
}

void BootAnimation::run(TftDisplay& tft, WebServer* server) {
    _tft_ptr = &tft.getTft();
    _server_ptr = server;
    _orange = tft.getTft().color565(218, 17, 0);

    // Boot splash
    tft.getTft().fillScreen(_orange);
    tft.getTft().setTextColor(ST77XX_WHITE);
    tft.getTft().setTextSize(3);
    tft.getTft().setCursor(66, 98);
    tft.getTft().print("Clawd");
    tft.getTft().setCursor(66, 134);
    tft.getTft().print("Mochi");
    delay(1200);

    // Logo reveal - line by line
    tft.getTft().fillScreen(_orange);
    for (uint16_t i = 0; i < LOGO_SEG_COUNT; i++) {
        int16_t x1 = pgm_read_word(&LOGO_SEGS[i][0]);
        int16_t y1 = pgm_read_word(&LOGO_SEGS[i][1]);
        int16_t x2 = pgm_read_word(&LOGO_SEGS[i][2]);
        int16_t y2 = pgm_read_word(&LOGO_SEGS[i][3]);
        tft.getTft().drawLine(x1, y1, x2, y2, ST77XX_WHITE);
        tft.getTft().drawLine(x1 + 1, y1, x2 + 1, y2, ST77XX_WHITE);
        if (i % 4 == 0) {
            if (_server_ptr) _server_ptr->handleClient();
            delay(8);
        }
    }

    // Fill logo
    for (uint16_t i = 0; i < LOGO_TRI_COUNT; i++) {
        tft.getTft().fillTriangle(
            pgm_read_word(&LOGO_TRIS[i][0]), pgm_read_word(&LOGO_TRIS[i][1]),
            pgm_read_word(&LOGO_TRIS[i][2]), pgm_read_word(&LOGO_TRIS[i][3]),
            pgm_read_word(&LOGO_TRIS[i][4]), pgm_read_word(&LOGO_TRIS[i][5]),
            ST77XX_WHITE);
    }
    tft.getTft().setTextColor(ST77XX_WHITE);
    tft.getTft().setTextSize(2);
    tft.getTft().setCursor(66, 210);
    tft.getTft().print("Anthropic");
    delay(1500);
}
